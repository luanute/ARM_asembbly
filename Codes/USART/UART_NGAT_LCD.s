RCC EQU 0x40021000
RCC_APB2ENR EQU 0x40021018	
	
GPIOA_CRL	EQU 0x40010800
GPIOA_CRH	EQU 0x40010804
GPIOA_IDR	EQU 0x40010808
GPIOA_ODR	EQU 0x4001080C

GPIOB_CRL	EQU 0x40010C00
GPIOB_CRH	EQU 0x40010C04
GPIOB_IDR	EQU 0x40010C08
GPIOB_ODR	EQU 0x40010C0C

UART_2 EQU 0x40004400
UART_2_CR1 EQU 0x4000440C
UART_2_DR EQU 0x40004404
	
NVIC_ISER0	EQU 0xE000E100
	AREA myData, DATA, READONLY
;Lenh, xem bang
setup DCB 0x58, 0xE, 0x1
	AREA MAIN, CODE, READONLY
	EXPORT __main
	EXPORT USART2_IRQHandler
__main
	;NGAT UART
	LDR R0, =NVIC_ISER0 + 4
	LDR R1, =0x40
	STR R1, [R0]
	
	;ENABLE CLOCK
	LDR	R1,=RCC_APB2ENR
	LDR R0,[R1]			
	ORR R0,R0,#0xC		
	STR R0,[R1]			
	
	;enable UART2
	LDR R0, =RCC
	LDR R1, =0xF0000
	STR R1, [R0,#0x1C]
	
	;SET UP GPIOA FOR UART
	LDR R0, =GPIOA_CRL
	LDR R1, =0x08B00
	STR R1, [R0]
	
	;SET UP GPIOB FOR LCD
	LDR R1,=GPIOB_CRL
	LDR R0,=0x33333333	
	STR R0,[R1]			
	LDR R1,=GPIOB_CRH
	LDR R0,=0x33
	STR R0,[R1]			
	
	;SET UP UART_2;
	
	;set up UART_2_CR1
	LDR R0, =UART_2
	LDR R1, =0x0202C
	STR R1,[R0,#0x0C]
	
	;baud rate
	LDR R1, = 0x1D4C
	STR R1,[R0,#0x08]
	
	;SET UP LCD
	LDR R5, =setup
SET_UP
	LDRB R3, [R5]
	CMP R3, #0x0
	BNE CONGG
	CMP R3, #0x0
	BEQ OUT_setup
CONGG
	BL GHI_LENH
	ADD R5, R5, #1
tiepp	
	B SET_UP
	
OUT_setup

LOOP B LOOP

GHI_LENH
	PUSH {LR}
	
	LDR R1,=GPIOB_ODR
	ADD R3, R3, #0x200
	STR R3,[R1]
	
	BL delay
	
	SUB R3, R3, #0x200
	LDR R1,=GPIOB_ODR
	STR R3,[R1]
	
	BL delay
	POP{LR}
	
	MOV PC, LR
USART2_IRQHandler
	LDR R0,=UART_2_DR
	;Lay du lieu len
	LDR R9, [R0]
	;Truyen du lieu
	STR R9,[R0]
;GHI LEN LCD
GHI_DATA
	LDR R1,=GPIOB_ODR
	ADD R9, R9, #0x300
	STR R9,[R1]	
delay1
	LDR R7,= 20000
d_L11	SUBS R7,R7,#1		
		BNE d_L11
	
	SUB R9, R9, #0x200
	LDR R1,=GPIOB_ODR
	STR R9,[R1]
	
	BX LR
	
delay
	LDR R7,= 20000
d_L	SUBS R7,R7,#1		
		BNE d_L
		BX	LR	
		END