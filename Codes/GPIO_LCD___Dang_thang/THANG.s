RCC_APB2ENR EQU 0x40021018	
	
GPIOA_CRL	EQU 0x40010800
GPIOA_IDR	EQU 0x40010808

GPIOB_CRL	EQU 0x40010C00
GPIOB_CRH	EQU 0x40010C04
GPIOB_ODR	EQU 0x40010C0C

	AREA myData, DATA, READONLY
setup DCD 0x58, 0xE, 0x1; giao tiep 32 bit,2 dong;hien thi, bat con tro;xoa toan bo nd

data DCD 0x0
KIEN_TRUC_MAY_TINH DCD 0x4B, 0X49, 0X45, 0X4E, 0X8, 0X54, 0X52, 0X55, 0X43, 0X8, 0X4D, 0X41, 0X59, 0X08, 0X54, 0X49, 0X4E, 0X48
Thay_Khoa DCD 0X08,0X08,0X08,0X08,0X08,0X08,0X08, 0X54, 0X68, 0X61, 0X79, 0X08, 0X4B, 0X68, 0X6F, 0X61,0X08,0X08,0X08,0X08
COOA335364_03CLC DCD 0X43, 0X4F, 0X4F, 0X41, 0X33, 0X33, 0X35, 0X33, 0X36, 0X34, 0X5F, 0X30, 0X33, 0X43, 0X4C, 0X43,0X08,0X08
Sang_thu_3 DCD 0X08,0X08,0X08,0X08,0X53, 0X61, 0X6E, 0X67, 0X08, 0X74, 0X68, 0X75, 0X08, 0X33;0xFFFFFFFF
	
	AREA MAIN, CODE, READONLY
	EXPORT __main
__main
	;ENABLE CLOCK
	LDR	R1,=RCC_APB2ENR
	LDR R0,[R1]			
	ORR R0,R0,#0xFC		
	STR R0,[R1]			
	
	;SET UP GPIOB
	LDR R1,=GPIOB_CRL
	LDR R0,=0x33333333	
	STR R0,[R1]		
	
	LDR R1,=GPIOA_CRL
	LDR R0,=0x8
	STR R0,[R1]	
	
	LDR R1,=GPIOB_CRH
	LDR R0,=0x33
	STR R0,[R1]		
XX	
	;SET UP LCD
	LDR R5, =setup;
SET_UP
	LDR R3, [R5]
	CMP R3, #0x0
	BNE CONGG; khac 
	CMP R3, #0x0
	BEQ OUT_setup; bang
CONGG
	BL GHI_LENH
	ADD R5, R5, #4	
	B SET_UP
OUT_setup
	;DATA
	LDR R4, =data
LOOP
	LDR R0, [R4]
	CMP R0, #0xFFFFFFFF
	BNE CONG
	CMP R0, #0xFFFFFFFF
	BEQ S
	B LOOP
CONG
	BL GHI_DATA
	BL nn
	B LOOP
GHI_LENH
	PUSH {LR}
	
	LDR R1,=GPIOB_ODR
	ADD R3, R3, #0x200;E=1, =0
	STR R3,[R1]
	
	BL delay
	
	SUB R3, R3, #0x200
	LDR R1,=GPIOB_ODR;E=0, =0
	STR R3,[R1]
	
	BL delay
	POP{LR}
	
	BX LR
GHI_DATA
	PUSH {LR}
	
	LDR R1,=GPIOB_ODR
	ADD R0, R0, #0x300
	STR R0,[R1]
	
	BL delay
	
	SUB R0, R0, #0x200
	LDR R1,=GPIOB_ODR
	STR R0,[R1]
	
	BL delay
	POP{LR}
	
	BX LR
XX2
	LDR R5, =setup
SET_UP2
	LDR R3, [R5]
	CMP R3, #0x0
	BNE CONGG2; khac
	CMP R3, #0x0
	BEQ TIEPP; bang
CONGG2
	BL GHI_LENH
	ADD R5, R5, #4
	B SET_UP2
LUU 
	STR R4,[R11]
	B TIEP
nn
	ADD R12,R12,#1; r12=0+1
	CMP R12,#37
	BEQ LUU; bang
TIEP
	ADD R4, R4, #4
	CMP R12, #38
	BCC LOOP; be
	
	LDR R1,=GPIOA_IDR
	LDR R2,[R1]
	BL delay
	CMP R2,#1
	BNE OUT_setup; khac
	
	;NEU R2=1
	CMP R10,#0X0
	BEQ XX2
TIEPP	
	LDR R9,[R11]
	BL delay
	ADD R10,R10,#4
	ADD R4, R9, R10
	B LOOP
delay
		LDR R7,= 20000
d_L1	SUBS R7,R7,#1				
		BNE d_L1
		BX	LR	
S B S		
		END